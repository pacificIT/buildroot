## package/stak/Config.in
```kconfig
menu "Stak"
	depends on BR2_arm

	config BR2_PACKAGE_META_OTTO
	bool "otto-full-stack"
	depends on BR2_arm
	select BR2_PACKAGE_CREATE_AP
	select BR2_PACKAGE_OTTOUPDATE
	select BR2_PACKAGE_PYTHON
	select BR2_PACKAGE_PYTHON_BOTTLE
	help
	  Full software stack for OTTO camera

	source package/stak/ottosdk/Config.in

	menu "Libraries"
		source package/stak/platform/generic/OttDate/Config.in
		source package/stak/platform/generic/fwup/Config.in
		source package/stak/platform/generic/fwup/Config.in.host
		source package/stak/platform/raspberrypi/libbcm2835/Config.in
		source package/stak/platform/raspberrypi/armmem/Config.in
		source package/stak/platform/raspberrypi/gifsicle/Config.in
		source package/stak/platform/raspberrypi/rpi-userland/Config.in
		source package/stak/platform/raspberrypi/dcfldd/Config.in
		source package/stak/platform/raspberrypi/otto-fastcamd/Config.in
		source package/stak/platform/raspberrypi/otto-boot/Config.in
		source package/stak/platform/raspberrypi/otto-wifi/Config.in
		source package/stak/platform/raspberrypi/otto-logo/Config.in
		source package/stak/platform/raspberrypi/otto-shutdown/Config.in
		source package/stak/platform/raspberrypi/otto-hostname/Config.in
		source package/stak/platform/raspberrypi/ottoupdate/Config.in
		source package/stak/platform/raspberrypi/otto-gfx/Config.in
		source package/stak/platform/raspberrypi/otto-runner/Config.in
		source package/stak/platform/raspberrypi/otto-menu/Config.in
		source package/stak/platform/raspberrypi/otto-network-setup/Config.in
		source package/stak/platform/raspberrypi/otto-gif-mode/Config.in
		source package/stak/platform/raspberrypi/libOttoHardware/Config.in
		source package/stak/platform/raspberrypi/nanosvg/Config.in
		source package/stak/platform/raspberrypi/create_ap/Config.in
		source package/stak/platform/rtl81xx/Config.in
	endmenu
endmenu
```

## package/stak/ottosdk/Config.in
```kconfig
config BR2_PACKAGE_OTTOSDK
	bool "ottosdk"
	depends on BR2_arm
	select BR2_PACKAGE_JPEG
	select BR2_PACKAGE_LIBBCM2835
	select BR2_PACKAGE_RPI_USERLAND
	select BR2_PACKAGE_GIFSICLE
	help
	  Hardware Test For Stak
```

## package/stak/platform/generic/OttDate/Config.in.host
```kconfig
config BR2_PACKAGE_HOST_OTTDATE
        bool "OttDate (host)"
        help
          The Otto Updater

          http://github.com/NextThingCo/OttDate
```

## package/stak/platform/raspberrypi/nanovg/Config.in
```kconfig
config BR2_PACKAGE_NANOVG
	bool "nanovg"
	depends on BR2_arm
	help
	  NanoVG is small antialiased vector graphics rendering library for OpenGL. It has lean API modeled after HTML5 canvas API. It is aimed to be a practical and fun toolset for building scalable user interfaces and visualizations.
```

## package/stak/platform/raspberrypi/otto-gif-mode/Config.in
```kconfig
config BR2_PACKAGE_OTTO_GIF_MODE
	bool "otto-gif-mode"
	depends on BR2_arm
	depends on BR2_PACKAGE_HAS_LIBEGL
        depends on BR2_PACKAGE_HAS_LIBGLES
        depends on BR2_PACKAGE_HAS_LIBOPENVG
        depends on BR2_PACKAGE_HAS_LIBOPENMAX
	help
	  Hardware Interface library for the BCM2835 chip.

	  http://www.airspayce.com/mikem/bcm2835/
```

## package/stak/platform/raspberrypi/otto-still-mode/Config.in
```kconfig
config BR2_PACKAGE_OTTO_STILL_MODE
	bool "otto-still-mode"
	depends on BR2_arm
	help
		New Still Mode
```
